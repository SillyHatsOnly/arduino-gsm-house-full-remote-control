              // БИБЛИОТЕКИ
#include       <iarduino_GSM.h>                                                                       // Подключаем библиотеку iarduino_GSM для работы с GSM/GPRS Shield.
#include       <SoftwareSerial.h>                                                                     // Подключаем библиотеку SoftwareSerial для программной реализации шины UART.
iarduino_GSM    gsm;                                                                                  // Создаём объект gsm для работы с функциями и методами библиотеки iarduino_GSM.
SoftwareSerial  softSerial(7, 8);                                                                     // Создаём объект softSerial для работы по программной шине UATR, указывая выводы RX и TX платы Arduino (выводы 7 и 8)
              // ПЕРЕМЕННЫЕ
uint8_t         Sum        = 0;                                                                       // Переменная для хранения процентного значения ШИМ-сигнала
              // Для отправки СМС о удачном запуске устройства, укажите в строке ниже номер телефона без пробелов.
char            SMSnum[13] = "7_ВАШ_НОМЕР_ТЕЛЕФОНА";                                                 // Объявляем строку для хранения номера отправителя SMS сообщений.
char            SMStxt[161];                                                                          // Объявляем строку для хранения текста принятых SMS сообщений.
String          strSMStxt;                                                                            // переменная типа String для более удобной работы
uint8_t         flgFunc;                                                                              // флаг наличия действия
uint8_t         flgDev;                                                                               // флаг наличия устройства
uint8_t         flgPWM;                                                                               // флаг наличия ШИМ
uint8_t         lvlPWM;                                                                               // Переменная количества символов в строке
const char*     Func[2][5] = {{"ВКЛЮЧИТЬ", "ВЫКЛЮЧИТЬ"},                                              // Двумерный массив с функциями и устройствами
                              {"СВЕТ КУХНЯ" , "СВЕТ КОМНАТА", "ДВЕРЬ", "ВЕНТИЛЯТОР", "ПОДСВЕТКА"}};   // 
const char      Pins[]     =  {     2,             3,            4,         5,           6       };   // Массив с номерами выводов устройств
                                                                                                      // 
void setup() {                                                                                        //
                // Инициируем GSM/GPRS Shield и проверяем его готовность к работе:
  gsm.begin(softSerial);                                                                              // Инициируем работу GSM/GPRS Shield, указывая объект шины UART.
  while (gsm.status() != GSM_OK) { delay(1000); }                                                     // Ждём завершения регистрации модема в сети оператора связи.
                // Установка кодировки для символов Кириллицы:
  gsm.TXTsendCodingDetect("п");                                                                       // Выполняем автоопределение кодировки скетча для отправки текста на Русском языке.
                // Отправка сообщения об удачном запуске:
  gsm.SMSsend( F("Инициализация прошла успешно."), SMSnum);                                           // Данная строка будет отвечать отправителю указанным SMS сообщением.
                // Настраиваем выводы
  pinMode(Pins[0],   OUTPUT);                                                                         // настройка вывода на работу в режиме выхода
  pinMode(Pins[1],   OUTPUT);                                                                         // настройка вывода на работу в режиме выхода
  pinMode(Pins[2],   OUTPUT);                                                                         // настройка вывода на работу в режиме выхода
  pinMode(Pins[3],   OUTPUT);                                                                         // настройка вывода на работу в режиме выхода
  pinMode(Pins[4],   OUTPUT);                                                                         // настройка вывода на работу в режиме выхода
  digitalWrite(Pins[0], LOW);                                                                         // устанавливаем на выходе значение сигнала равным LOW
  digitalWrite(Pins[1], LOW);                                                                         // устанавливаем на выходе значение сигнала равным LOW
  digitalWrite(Pins[2], LOW);                                                                         // устанавливаем на выходе значение сигнала равным LOW
  digitalWrite(Pins[3], LOW);                                                                         // устанавливаем на выходе значение сигнала равным LOW
  digitalWrite(Pins[4], LOW);                                                                         // устанавливаем на выходе значение сигнала равным LOW
  flgFunc = 20;                                                                                       // Сбрасываем флаг
  flgDev  = 20;                                                                                       // Сбрасываем флаг
  flgPWM  =  0;                                                                                       // Сбрасываем флаг
}                                                                                                     // 
                                                                                                      // 
void loop () {                                                                                        // 
  if (millis() % 1000 < 100) {                                                                        // Выполняем код в теле оператора if первые 100 мс каждой секунды.
    delay(100);                                                                                       // Устанавливаем задержку в 100 мс, чтоб не выполнить код более 1 раза за секунду.
    if (gsm.SMSavailable()) {                                                                         // Функция SMSavailable() возвращает количество входящих непрочитанных SMS сообщений.
      gsm.SMSread(SMStxt, SMSnum);                                                                    // Читаем SMS сообщение в ранее объявленные переменные (текст SMS сообщения, адрес отправителя, дата отправки, идентификатор SMS, количество SMS, номер SMS).
      strSMStxt = SMStxt;                                                                             // Присваиваем массиву atrSMStxt значения массива SMStxt для дальнейшей проверки на совпадения
      for (int m = 0; m < (sizeof(Func[0]) / 2); m++) {                                               // проверяем в цикле, совпадает ли команда из массива с тем, что пришло в СМС
        if (strSMStxt.indexOf(Func[0][m]) > -1 && *Func[0][m] != 0) {                                 // если совпадения есть, то
          flgFunc = m;                                                                                // присваиваем флагу порядковый номер совпавшего слова из массива Func
          for (int i = 0; i < (sizeof(Func[1]) / 2); i++) {                                           // проверяем в цикле, совпадает ли имя устройства из массива с тем, что пришло в СМС
            if (strSMStxt.indexOf(Func[1][i]) > -1 && *Func[1][i] != 0) {                             // если совпадения есть и это не пустая строка, то
              flgDev = i;                                                                             // присваиваем флагу порядковый номер совпавшего слова из массива Device
              if (strchr(SMStxt, '%')) {                                                              // проверяем, есть ли в тексте СМС символ %
                flgPWM = 1;                                                                           // и если есть, то устанавливаем флаг
              }                                                                                       //
            }                                                                                         //
          }                                                                                           //
        }                                                                                             //
      }                                                                                               //
      if (flgPWM == 1) {                                                                              // если установлен флаг flgPWM, то
        lvlPWM = uint8_t(strchr(SMStxt, '%' ) - SMStxt);                                              // определяем количество символов в строке до совпадения с символом %
        if (SMStxt[lvlPWM - 1] >= '0' && SMStxt[lvlPWM - 1] <= '9') {                                 // Проверяем, является ли символ, расположенный в строке на 1 позицию левее символа %, цифрой от 0 до 9, и если да, то
          Sum = uint8_t(SMStxt[lvlPWM - 1] - '0');                                                    // прибавляем эту цифру к переменной (единицы)
          if (SMStxt[lvlPWM - 2] >= '0' && SMStxt[lvlPWM - 2] <= '9') {                               // Проверяем, является ли символ, расположенный в строке на 2 позиции левее символа %, цифрой от 0 до 9, и если да, то
            Sum += uint8_t((SMStxt[lvlPWM - 2] - '0') * 10);                                          // прибавляем эту цифру к переменной, умножив на 10 (десятки)
            if (SMStxt[lvlPWM - 3] > '0' && SMStxt[lvlPWM - 3] <= '1') {                              // Проверяем, является ли символ, расположенный в строке на 3 позиции левее символа %, цифрой от 0 до 1, и если да, то
              Sum += uint8_t((SMStxt[lvlPWM - 3] - '0') * 100) ;                                      // прибавляем эту цифру к переменной, умножив на 100 (сотни)
            } else                                                                                    // иначе проверяем, что
              if (SMStxt[lvlPWM - 3] >= '2' && SMStxt[lvlPWM - 3] <= '9') {                           // число "сотен" не больше 1, и если больше то
                flgPWM = 0;                                                                           // сбрасываем флаг ШИМ
              }                                                                                       // 
          }                                                                                           //
        }                                                                                             //
      }                                                                                               //
      if (flgFunc != 20) {                                                                            // если флаг flgFunc установлен, то
        switch (flgFunc) {                                                                            // проверяем значение флага flgFunc с определёнными в операторе case
          case 0:                                                                                     // Если 0 - значит указано действие ВКЛЮЧИТЬ
            if (flgDev != 20) {                                                                       // Если установлен флаг наличия устройства, то
              if (flgPWM == 1) {                                                                      // проверяем флаг ШИМ. Если он установлен, то
                uint8_t mapPWM = map(Sum, 0, 100, 0, 255);                                            // переопределяем множество для ШИМ и
                analogWrite(Pins[flgDev], mapPWM );                                                   // подаём ШИМ-сигнал на вывод и
                gsm.SMSsend(F("Процент задан!"), SMSnum);                                             // отправляем сообщение об успешном выполнении.
                Sum    = 0;                                                                           // сбрасываем количество процентов для задания ШИМ-сигнала после выполнения
                flgPWM = 0;                                                                           // сбрасываем флаг ШИМ после выполнения
              }                                                                                       //
              else {                                                                                  // Если же флага ШИМ нет, то
                digitalWrite(Pins[flgDev], HIGH);                                                     // подаём высокий сигнал на вывод для включения и
                gsm.SMSsend(F("Устройство включено!"), SMSnum);                                       // отправляем сообщение об успешном выполнении.
              }                                                                                       //
              flgDev = 20;                                                                            // сбрасываем флаг устройства после выполнения
            } else {                                                                                  // если в СМС не указано устройство, то
              gsm.SMSsend(F("Что включить?"), SMSnum);                                                // отправляем об этом сообщение
            }                                                                                         // 
            flgFunc = 20;                                                                             // сбрасываем флаг действия после выполнения
            break;                                                                                    //
          case 1:                                                                                     // Если 1 - значит указано действие ВЫКЛЮЧИТЬ
            if (flgDev != 20) {                                                                       // Если установлен флаг наличия устройства, то
              digitalWrite(Pins[flgDev], LOW);                                                        // подаём низкий сигнал на вывод для выключения
              gsm.SMSsend(F("Устройство выключено!"), SMSnum);                                        // и отправляем сообщение об успешном выполнении.
              flgDev = 20;                                                                            // сбрасываем флаг устройства после выполнения
            } else {                                                                                  // если в СМС не указано устройство, то
              gsm.SMSsend(F("Что выключить?"), SMSnum);                                               // отправляем об этом сообщение
            }                                                                                         // 
            flgFunc = 20;                                                                             // сбрасываем флаг действия после выполнения
            break;                                                                                    //
        }                                                                                             //
      } else {                                                                                        //
        gsm.SMSsend(F("Ошибка в тексте!"), SMSnum);                                                   // Если текст пришёл не верный, то отправляем об этом сообщение
      }                                                                                               //
    }                                                                                                 //
  }                                                                                                   //
}                                                                           
